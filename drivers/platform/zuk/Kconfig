## drivers/platform/zuk/Kconfig
```kconfig
# Zuk configuration options

menu "Zuk board selection"
	config MACH_ZUK_Z2_PLUS
		bool "ZUK_Z2_Plus_board"
		select MACH_ZUK_MSM8996
		help
		  Support for Zuk Z2 Plus variant

	config MACH_ZUK_Z2_ROW
		bool "ZUK_Z2_ROW_board"
		select MACH_ZUK_MSM8996
		help
		  Support for Zuk Z2_ROW variant
endmenu
```
